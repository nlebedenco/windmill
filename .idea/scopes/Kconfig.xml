## firmware/west.yml
```yaml
# $schema: zephyr/manifest-schema.yml
# See https://docs.zephyrproject.org/latest/develop/west/manifest.html#west-manifests for more information.
manifest:
  version: "1.2"
  self:
    west-commands: scripts/west-commands.yml
    import:
      # This prefix is referred in:
      #   - <PROJECT_ROOT>/.west/config
      #   - <PROJECT_ROOT>/extras/cppcheck/supressions.txt
      # If you change it here, make sure to update those files too.
      path-prefix: .external
      # Import all YAML files in the submanifests folder, as they appear on the file system, sorted by file name. Note
      # that projects and modules are imported only once with the settings from the point where they are first referred
      # to so submanifest files imported first can override project/module from manifest files imported later. It is
      # thus recommended for all submanifest files to begin with a numeric prefix `XXX-` to enforce a clear order.
      file: zephyr/submanifests
```

## firmware/zephyr/apps/example_blink/Kconfig
```kconfig
# This file is the Kconfig entry point of the firwmare. All application Kconfig options can be defined here or included
# via other application Kconfig files. You can browse these options using the west targets menuconfig (terminal) or
# guiconfig (GUI).
mainmenu "Firmware Configuration"

# Application configuration options go here
menu "Application"

endmenu

# Sources Kconfig.zephyr from the Zephyr root directory.
#
# NOTE: All 'source' statements work relative to the Zephyr root directory (due to the $srctree environment variable
# being set to $ZEPHYR_BASE). If you want to 'source' relative to the current Kconfig file instead, use 'rsource' (or a
# path relative to the Zephyr root).
source "Kconfig.zephyr"

# In order to use logging in a module, a unique name must be specified and the module must be registered in code using
# the LOG_MODULE_REGISTER function macro. Additionally, a maximum compiled-in log level for the module can be specified
# as the second parameter. The Kconfig template below defines helps to define this maximum log level using config
# options. As a result CONFIG_APP_LOG_LEVEL will be generated. Default log level (CONFIG_LOG_DEFAULT_LEVEL) is used if
# a custom log level is not specified.
# See https://docs.zephyrproject.org/latest/services/logging/index.html#logging-in-a-module
module = APP
module-str = app
source "subsys/logging/Kconfig.template.log_config"
```

## firmware/zephyr/lib/windmill/dummy/Kconfig
```kconfig
config WINDMILL_DUMMY
    bool "Enable the windmill dummy library"
    help
      This option enables the 'windmill dummy' library

config WINDMILL_DUMMY_GET_VALUE_DEFAULT
    int "Default value returned by windmill_dummy_get_value()"
    depends on WINDMILL_DUMMY
    default 0
    help
      This option primarily exists as an example of a library Kconfig
      setting.

      This option specifies the value for windmill_dummy_get_value() to return
      when the input parameter is zero. (Otherwise the function returns the
      input parameter value.)
```
